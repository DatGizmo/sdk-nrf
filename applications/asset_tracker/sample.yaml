## applications/asset_tracker/sample.yaml
```yaml
sample:
  name: Asset Tracker Application
tests:
  applications.asset_tracker:
    build_only: true
    build_on_all: true
    tags: ci_build
```

## applications/asset_tracker_v2/sample.yaml
```yaml
sample:
  name: Asset Tracker v2 Application
tests:
  applications.asset_tracker_v2:
    build_only: true
    build_on_all: true
    extra_configs:
      - CONFIG_AWS_IOT_BROKER_HOST_NAME="example-hostname.aws.com"
    tags: ci_build
```

## applications/connectivity_bridge/sample.yaml
```yaml
sample:
  description: Connectivity Bridge application
  name: Connectivity Bridge
tests:
  applications.connectivity_bridge:
    build_only: true
    build_on_all: true
    tags: ci_build
```

## samples/bluetooth/alexa_gadget/sample.yaml
```yaml
sample:
  name: Alexa Gadget sample
  description: Sample implementing Alexa Gadgets Service and Profile
tests:
  samples.bluetooth.alexa_gadget:
    build_only: true
    build_on_all: true
    tags: bluetooth ci_build
```

## samples/bluetooth/central_hr_coded/sample.yaml
```yaml
sample:
  name: Bluetooth LE central HR Coded
  description: Bluetooth Low Energy central heart rate service connecting on LE Coded PHY
tests:
  samples.bluetooth.central_hr_coded:
    build_only: true
    build_on_all: true
    tags: bluetooth ci_build
```

## samples/bluetooth/central_uart/sample.yaml
```yaml
sample:
  name: BLE Central UART
  description: Bluetooth Low Energy central UART sample
tests:
  samples.bluetooth.central_uart:
    build_only: true
    build_on_all: true
    tags: bluetooth ci_build
```

## samples/bluetooth/enocean/sample.yaml
```yaml
sample:
  name: EnOcean
  description: Sample demonstrating basic usage of the EnOcean library
tests:
  samples.bluetooth.enocean:
    build_only: true
    build_on_all: true
    tags: bluetooth ci_build
```

## samples/bluetooth/hci_lpuart/sample.yaml
```yaml
sample:
  description: TBD
  name: TBD
tests:
  sample.bluetooth.hci_lpuart:
    tags: uart bluetooth
```

## samples/bluetooth/llpm/sample.yaml
```yaml
sample:
  name: BLE LLPM
  description: Buetooth Low Energy LLPM sample
tests:
  samples.bluetooth.llpm:
    build_only: true
    build_on_all: true
    tags: bluetooth ci_build
```

## samples/bluetooth/mesh/chat/sample.yaml
```yaml
sample:
  name: Bluetooth Mesh Chat
  description: Bluetooth Mesh Chat sample
tests:
  samples.bluetooth.mesh.chat:
    build_only: true
    build_on_all: true
    tags: bluetooth ci_build
```

## samples/bluetooth/mesh/light/sample.yaml
```yaml
sample:
  name: Bluetooth mesh light
  description: Bluetooth mesh light sample
tests:
  samples.bluetooth.mesh.light:
    build_only: true
    build_on_all: true
    tags: bluetooth ci_build
```

## samples/bluetooth/mesh/light_ctrl/sample.yaml
```yaml
sample:
  name: Bluetooth mesh light fixture
  description: Bluetooth mesh light fixture sample
tests:
  samples.bluetooth.mesh.light_ctrl:
    build_only: true
    build_on_all: true
    tags: bluetooth ci_build
```

## samples/bluetooth/mesh/light_switch/sample.yaml
```yaml
sample:
  name: Bluetooth mesh light switch
  description: Bluetooth mesh light switch sample
tests:
  samples.bluetooth.mesh.light_switch:
    build_only: true
    build_on_all: true
    tags: bluetooth ci_build
```

## samples/bluetooth/mesh/sensor_client/sample.yaml
```yaml
sample:
  name: Bluetooth mesh sensor observer
  description: Bluetooth mesh sensor observer sample
tests:
  samples.bluetooth.mesh.sensor_client:
    build_only: true
    build_on_all: true
    tags: bluetooth ci_build
```

## samples/bluetooth/mesh/sensor_server/sample.yaml
```yaml
sample:
  name: Bluetooth mesh sensor
  description: Bluetooth mesh sensor sample
tests:
  samples.bluetooth.mesh.sensor_server:
    build_only: true
    build_on_all: true
    tags: bluetooth ci_build
```

## samples/bluetooth/peripheral_bms/sample.yaml
```yaml
sample:
  name: BLE Bond Management service
  description: Bluetooth Low Energy Bond Management service sample
tests:
  samples.bluetooth.peripheral_bms:
    build_only: true
    build_on_all: true
    tags: bluetooth ci_build
```

## samples/bluetooth/peripheral_cts_client/sample.yaml
```yaml
sample:
  name: BLE CTS client sample
  description: Bluetooth Low Energy CTS client sample
tests:
  samples.bluetooth.peripheral_cts_client.build:
    build_only: true
    build_on_all: true
    tags: bluetooth ci_build
```

## samples/bluetooth/peripheral_gatt_dm/sample.yaml
```yaml
sample:
  name: BLE Gatt Discovery
  description: Bluetooth Low Energy Gatt client discovery manager sample
tests:
  samples.bluetooth.peripheral_gatt_dm:
    build_only: true
    build_on_all: true
    tags: bluetooth ci_build
```

## samples/bluetooth/peripheral_hr_coded/sample.yaml
```yaml
sample:
  name: Bluetooth LE peripheral HR Coded
  description: Bluetooth Low Energy peripheral heart rate service connecting on LE Coded PHY
tests:
  samples.bluetooth.peripheral_hr_coded:
    build_only: true
    build_on_all: true
    tags: bluetooth ci_build
```

## samples/bluetooth/peripheral_lbs/sample.yaml
```yaml
sample:
  name: BLE LED Button service
  description: Bluetooth Low Energy LED Button service sample
tests:
  samples.bluetooth.peripheral_lbs:
    build_only: true
    build_on_all: true
    tags: bluetooth ci_build
tests:
  samples.bluetooth.peripheral_lbs_minimal:
    extra_args: OVERLAY_CONFIG=minimal.conf
    build_only: true
    platform_allow: nrf51dk_nrf51422 nrf52dk_nrf52810
    tags: bluetooth ci_build
```

## samples/bluetooth/peripheral_nfc_pairing/sample.yaml
```yaml
sample:
  name: Bluetooth Low Energy Peripheral NFC Pairing reference
  description: Bluetooth Low Energy Peripheral NFC Pairing reference sample
tests:
  samples.bluetooth.peripheral_nfc_pairing:
    build_only: true
    build_on_all: true
    tags: bluetooth ci_build
```

## samples/bluetooth/peripheral_uart/sample.yaml
```yaml
sample:
  name: BLE UART service
  description: Bluetooth Low Energy UART service sample
tests:
  samples.bluetooth.peripheral_uart:
    build_only: true
    build_on_all: true
    tags: bluetooth ci_build
```

## samples/bluetooth/shell_bt_nus/sample.yaml
```yaml
sample:
  name: BT NUS shell
  description: BT NUS shell sample
tests:
  samples.bluetooth.shell_bt_nus:
    build_only: true
    build_on_all: true
    tags: bluetooth ci_build
```

## samples/bluetooth/throughput/sample.yaml
```yaml
sample:
  name: BLE throughput
  description: Bluetooth Low Energy throughput sample
tests:
  samples.bluetooth.throughput:
    build_only: true
    build_on_all: true
    tags: bluetooth ci_build
```

## samples/connectedhomeip/light_bulb/sample.yaml
```yaml
sample:
  name: CHIP Light Bulb
  description: CHIP Light Bulb example
tests:
  connectedhomeip.light_bulb:
    build_only: true
    build_on_all: true
    tags: ci_build
```
