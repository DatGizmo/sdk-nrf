## samples/connectedhomeip/light_switch/sample.yaml
```yaml
sample:
  name: CHIP Light Switch
  description: CHIP Light Switch example
tests:
  connectedhomeip.light_switch:
    build_only: true
    build_on_all: true
    tags: ci_build
```

## samples/connectedhomeip/lock/sample.yaml
```yaml
sample:
  name: CHIP Lock
  description: CHIP Lock example
tests:
  connectedhomeip.lock:
    build_only: true
    build_on_all: true
    tags: ci_build
```

## samples/debug/ppi_trace/sample.yaml
```yaml
sample:
  description: Sample showing PPI trace
  name: PPI trace sample
tests:
  samples.debug.ppi_trace:
    build_only: true
    build_on_all: true
    tags: ci_build
```

## samples/ei_data_forwarder/sample.yaml
```yaml
sample:
  description: Sample showing Edge Impulse data forwarder usage
  name: Edge Impulse data forwarder sample
tests:
  samples.ei_data_forwarder:
    build_only: true
    build_on_all: true
    tags: ci_build
```

## samples/event_manager/sample.yaml
```yaml
sample:
  description: Sample showing Event Manager usage
  name: Event Manager sample
tests:
  samples.event_manager:
    build_only: true
    build_on_all: true
    tags: ci_build
```

## samples/mpsl/timeslot/sample.yaml
```yaml
sample:
  description: MPSL timeslot sample
  name: Timeslot sample
tests:
  samples.mpsl.timeslot:
    build_only: true
    build_on_all: true
    tags: ci_build
```

## samples/nfc/record_text/sample.yaml
```yaml
sample:
  name: NFC Records text
  description: NFC Records text sample
tests:
  samples.nfc.record_text:
    build_only: true
    build_on_all: true
    tags: ci_build
```

## samples/nfc/system_off/sample.yaml
```yaml
sample:
  name: NFC System Off
  description: Wake up from system off by NFC field detect sample
tests:
  samples.nfc.system_off:
    build_only: true
    build_on_all: true
    tags: ci_build
```

## samples/nfc/tag_reader/sample.yaml
```yaml
sample:
  name: NFC Tag Reader
  description: NFC Tag Reader sample
tests:
  samples.nfc.tag_reader:
    build_only: true
    build_on_all: true
    tags: ci_build
```

## samples/nfc/tnep_poller/sample.yaml
```yaml
sample:
  description: TBD
  name: TBD
tests:
  samples.nfc.tnep_poller:
    build_only: true
    build_on_all: true
    tags: ci_build
```

## samples/nfc/tnep_tag/sample.yaml
```yaml
sample:
  description: TBD
  name: TBD
tests:
  samples.nfc.tnep_tag:
    build_only: true
    build_on_all: true
    tags: ci_build
```

## samples/nfc/writable_ndef_msg/sample.yaml
```yaml
sample:
  name: NFC Writable NDEF Message
  description: NFC Writable NDEF Message sample
tests:
  samples.nfc.writable_ndef_msg:
    build_only: true
    build_on_all: true
    tags: ci_build
```

## samples/nrf5340/empty_app_core/sample.yaml
```yaml
sample:
  name: Empty firmware for application core
  description: Minimal Zephyr configuration sample that only suspends CPU.
tests:
  samples.nrf5340.empty_app_core.build:
    build_only: true
    build_on_all: true
    tags: ci_build
```

## samples/nrf9160/agps/sample.yaml
```yaml
sample:
  name: A-GPS sample
tests:
  samples.nrf9160.agps:
    build_only: true
    build_on_all: true
    tags: ci_build
```

## samples/nrf9160/at_client/sample.yaml
```yaml
sample:
  name: at_client Sample
tests:
  samples.nrf9160.at_client:
    build_only: true
    build_on_all: true
    tags: ci_build
```

## samples/nrf9160/aws_fota/sample.yaml
```yaml
sample:
  name: AWS IoT Jobs FOTA sample
tests:
  samples.nrf9160.aws_fota:
    build_only: true
    build_on_all: true
    tags: ci_build
```

## samples/nrf9160/aws_iot/sample.yaml
```yaml
sample:
  name: AWS IoT sample
tests:
  samples.nrf9160.aws_iot:
    build_only: true
    build_on_all: true
    tags: ci_build
```

## samples/nrf9160/azure_fota/sample.yaml
```yaml
sample:
  name: Azure FOTA sample
tests:
  samples.nrf9160.azure_fota:
    build_only: true
    build_on_all: true
    tags: ci_build
```

## samples/nrf9160/azure_iot_hub/sample.yaml
```yaml
sample:
  name: Azure IoT Hub sample
tests:
  samples.nrf9160.azure_iot_hub:
    build_only: true
    build_on_all: true
    tags: ci_build
```

## samples/nrf9160/cloud_client/sample.yaml
```yaml
sample:
  name: Cloud client sample
tests:
  samples.nrf9160.cloud_client:
    build_only: true
    build_on_all: true
    tags: ci_build
```

## samples/nrf9160/fmfu_smp_svr/sample.yaml
```yaml
sample:
  description: Full modem firmware update Simple Management Protocol sample
  name: Full modem serial update sample
tests:
  samples.nrf9160.fmfu_smp_svr:
    build_only: true
    build_on_all: true
    tags: ci_build
```

## samples/nrf9160/gps/sample.yaml
```yaml
sample:
  name: GPS sample
tests:
  samples.nrf9160.gps:
    build_only: true
    build_on_all: true
    tags: ci_build
```

## samples/nrf9160/https_client/sample.yaml
```yaml
sample:
  name: HTTPS client sample
tests:
  samples.nrf9160.https_client:
    build_only: true
    build_on_all: true
    tags: ci_build
```

## samples/nrf9160/lte_ble_gateway/sample.yaml
```yaml
sample:
  name: LTE-BLE gateway sample
tests:
  samples.nrf9160.lte_ble_gateway:
    build_only: true
    build_on_all: true
    tags: ci_build
```

## samples/nrf9160/lwm2m_carrier/sample.yaml
```yaml
sample:
  name: LwM2M carrier sample
tests:
  samples.nrf9160.lwm2m_carrier:
    build_only: true
    build_on_all: true
    tags: ci_build
```
