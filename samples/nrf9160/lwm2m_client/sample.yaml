## samples/nrf9160/lwm2m_client/sample.yaml
```yaml
sample:
  name: nrf LwM2M Sample
tests:
  samples.nrf9160.lwm2m_client:
    build_only: true
    build_on_all: true
    extra_args: OVERLAY_CONFIG=overlay-ci.conf
    tags: ci_build
```

## samples/nrf9160/mqtt_simple/sample.yaml
```yaml
sample:
  name: mqtt simple sample
tests:
  samples.nrf9160.mqtt_simple:
    build_only: true
    build_on_all: true
    tags: ci_build
```

## samples/nrf9160/udp/sample.yaml
```yaml
sample:
  name: UDP sample
tests:
  samples.nrf9160.udp:
    build_only: true
    build_on_all: true
    tags: ci_build
```

## samples/nrf_rpc/entropy_nrf53/cpunet/sample.yaml
```yaml
sample:
  name: Entropy remote network core
  description: Entropy remote network core sample
tests:
  samples.nrf_rpc.entropy_cpunet:
    build_only: true
    build_on_all: true
```

## samples/openthread/cli/sample.yaml
```yaml
sample:
  name: OpenThread CLI sample
  description: Test OpenThread Command Line Interface.
tests:
  samples.openthread.cli:
    build_only: true
    build_on_all: true
    tags: ci_build
```

## samples/openthread/coap_client/sample.yaml
```yaml
sample:
  name: OpenThreadThread CoAP Client
  description: Test CoAP communication in Thread network
tests:
  samples.openthread.coap_client:
    build_only: true
    build_on_all: true
    tags: ci_build
```

## samples/openthread/coap_server/sample.yaml
```yaml
sample:
  name: OpenThread CoAP Server
  description: Test CoAP communication in Thread network
tests:
  samples.openthread.coap_server:
    build_only: true
    build_on_all: true
    tags: ci_build
```

## samples/openthread/ncp/sample.yaml
```yaml
sample:
  name: OpenThread NCP sample
  description: Test OpenThread NCP
tests:
  samples.openthread.ncp:
    build_only: true
    build_on_all: true
    tags: ci_build
```

## samples/peripheral/radio_test/sample.yaml
```yaml
sample:
  name: Radio Test
  description: Radio Test sample
tests:
  samples.peripheral.radio_test:
    build_only: true
    build_on_all: true
    tags: ci_build
```

## samples/profiler/sample.yaml
```yaml
sample:
  description: Sample showing Profiler usage
  name: Profiler sample
tests:
  samples.profiler:
    build_only: true
    build_on_all: true
    tags: ci_build
```

## samples/sensor/bh1749/sample.yaml
```yaml
sample:
  name: BH1749 Sensor Sample
tests:
  samples.sensor.bh1749:
    harness: sensor
    tags: sensors
    depends_on: i2c
```

## samples/spm/sample.yaml
```yaml
sample:
  name: spm Sample
tests:
  samples.nrf9160.spm:
    build_only: true
    build_on_all: true
    tags: ci_build
```

## samples/tfm/tfm_hello_world/sample.yaml
```yaml
sample:
  description: Hello World sample, the simplest Zephyr
    application, with TF-M enabled
  name: hello world TFM
common:
    tags: tfm
    harness: console
    harness_config:
      type: multi_line
      regex:
        - "Hello World! (.*)"
        - "SHA256 Digest: 0x.*"
tests:
  sample.tfm.helloworld:
    tags: tfm ci_build
```

## samples/zigbee/light_bulb/sample.yaml
```yaml
sample:
  name: Zigbee Light control
  description: Zigbee Light control - light bulb sample
tests:
  zigbee.light_bulb:
    build_only: true
    tags: ci_build smoke
```

## samples/zigbee/network_coordinator/sample.yaml
```yaml
sample:
  name: Zigbee Network coordinator
  description: Zigbee Light control - coordinator sample
tests:
  zigbee.network_coordinator:
    build_only: true
    tags: ci_build smoke
```
